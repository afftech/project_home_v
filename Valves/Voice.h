#include "Print.h"
#define S1 6
#define S2 7
#define S3 8
#define S4 9
class Voice {
public:
  voice() {
    pinMode(S1, OUTPUT);  //открыть кухню
    pinMode(S2, OUTPUT);  //закрыть кухню
    pinMode(S3, OUTPUT);  //открыть кухню
    pinMode(S4, OUTPUT);  //закрыть кухню
    //подтянуто к минусу
    digitalWrite(S1, false);
    digitalWrite(S2, false);
    digitalWrite(S3, false);
    digitalWrite(S4, false);
  }
  void process() {
    if (PlayState) {
      if (timer()) {
        digitalWrite(S1, false);
        digitalWrite(S2, false);
        digitalWrite(S3, false);
        digitalWrite(S4, false);
        PlayState = false;
      }
    }
  }
  bool Play(int i) {
    Serial.print(F("Voice:"));
    Serial.println(i);
    i = i - 1;
    digitalWrite(S1, SoundSelection[i][0]);
    digitalWrite(S2, SoundSelection[i][1]);
    digitalWrite(S3, SoundSelection[i][2]);
    digitalWrite(S4, SoundSelection[i][3]);
    PlayState = true;
    T1 = millis();
    return true;
  }
  bool timer() {
    if (millis() - T1 >= 1200) {
      /*Serial.println("millis() - T1");
      Serial.println(millis() - T1);*/
      return true;
    }
    return false;
  }
private:
  int SoundSelection[15][4]{
    //S1,S2,S3,S4
    { 1, 0, 0, 0 },  //1) Пришел сигнал с датчика протечки кухня (Сообщение: Сработала система контроля протечки, краны будут закрыты. Для открытия кранов в ручном режиме нажмите на кнопку в... )
    { 0, 1, 0, 0 },  //2) Нажата кнопка в кухне (Сообщение нажата кнопка управления кранами или звуковой сигнал "пик")
    { 1, 1, 0, 0 },  //3) После удержания 3 сек в кухне  или ванной подан сигнал на закрытие кранов (Сообщение: Краны будут закрыты, Система переходит  в режим пролива гидра затворов)
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    { 1, 1, 1, 1 }   //15) Не удалось обновить время и дату, после включения.
  };
  bool PlayState;
  long T1;
};